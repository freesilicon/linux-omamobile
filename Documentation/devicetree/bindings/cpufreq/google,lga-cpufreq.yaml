## Documentation/devicetree/bindings/soc/google/google,lga-aoc.yaml
```yaml
# SPDX-License-Identifier: (GPL-2.0-only OR BSD-2-Clause)
%YAML 1.2
---
$id: http://devicetree.org/schemas/soc/google/google,lga-aoc.yaml#
$schema: http://devicetree.org/meta-schemas/core.yaml#

title: Google Tensor G5 (Laguna) AoC (Always-on Compute)

maintainers:
  - Bobby Bones <saariuscrypto@gmail.com>

description:
  The Always-on Compute (AoC) subsystem on Google Tensor G5 (Laguna) is the
  audio and sensor DSP complex. The application processor loads signed firmware
  into a reserved DRAM carve-out, authenticates and starts it through the GSA
  mailbox (google,mba-ctrl v2.0) and Trusty hwmgr.aoc service, and exchanges
  IPC doorbells over 20 AoC-to-AP MBA v2.0 channels while the AoC accesses
  memory behind the AMB SMMUv3.

properties:
  compatible:
    const: google,lga-aoc

  reg:
    items:
      - description: AoC subsystem register and SRAM window (blk_aoc)
      - description: AoC local clock and power management registers (lcpm)

  reg-names:
    items:
      - const: blk_aoc
      - const: lcpm

  iommus:
    description: AMB SMMUv3 stream IDs assigned to the AoC complex
    minItems: 1
    maxItems: 2

  memory-region:
    maxItems: 1
    description: Reserved no-map DRAM carve-out where AoC firmware executes

  mboxes:
    description: AoC-to-AP google,mba-ctrl v2.0 doorbell and message channels
    minItems: 1
    maxItems: 20

  power-domains:
    items:
      - description: Top-level AoC SSWRP power domain (sswrp_aoc_pd)
      - description: AoC core sub-domain (aoc_core_pd)

  power-domain-names:
    items:
      - const: sswrp_aoc_pd
      - const: aoc_core_pd

  gsa-device:
    $ref: /schemas/types.yaml#/definitions/phandle
    description: GSA security core used to authenticate and start AoC firmware

  firmware-name:
    maxItems: 1
    description: Board-specific signed AoC firmware filename under /lib/firmware

  sensor-1v8-supply:
    description: 1.8 V sensor rail enabled before sensor-3v3-supply

  sensor-3v3-supply:
    description: 3.3 V sensor rail enabled after sensor-1v8-supply

  sensor-mag-supply:
    description: Optional magnetometer/auxiliary sensor supply

  google,board-id:
    $ref: /schemas/types.yaml#/definitions/uint32
    description: AoC board identifier passed in the boot parameter table

  google,board-rev:
    $ref: /schemas/types.yaml#/definitions/uint32
    description: AoC board revision passed in the boot parameter table

  google,board-cfg:
    $ref: /schemas/types.yaml#/definitions/string
    description: Short AoC board configuration tag (e.g. MT5 or RG5)

  google,gnss-type:
    $ref: /schemas/types.yaml#/definitions/uint32
    description: GNSS receiver type identifier passed to AoC firmware

  google,coredump-mbox:
    $ref: /schemas/types.yaml#/definitions/uint32
    description: Index in mboxes reserved for AoC coredump notifications

  wakeup-source: true

required:
  - compatible
  - reg
  - reg-names
  - memory-region
  - mboxes
  - power-domains
  - power-domain-names
  - gsa-device

additionalProperties: false

examples:
  - |
    aoc@9000000 {
        compatible = "google,lga-aoc";
        reg = <0x0 0x09000000 0x0 0x02000000>,
              <0x0 0x0b4c0000 0x0 0x0000be28>;
        reg-names = "blk_aoc", "lcpm";
        iommus = <&amb_smmu 0x8300>, <&amb_smmu 0x8309>;
        memory-region = <&aoc_rmem>;
        mboxes = <&aoc_ap_0_mba 0>, <&aoc_ap_1_mba 0>;
        power-domains = <&sswrp_aoc_pd>, <&aoc_core_pd>;
        power-domain-names = "sswrp_aoc_pd", "aoc_core_pd";
        gsa-device = <&gsa>;
        firmware-name = "google/aoc-mustang.bin";
        google,board-id = <0x70503>;
        google,board-rev = <0x10000>;
        google,board-cfg = "MT5";
        google,gnss-type = <2>;
        google,coredump-mbox = <19>;
        status = "disabled";
    };
```

## Documentation/devicetree/bindings/soc/google/google,s5910-spmi.yaml
```yaml
# SPDX-License-Identifier: (GPL-2.0-only OR BSD-2-Clause)
%YAML 1.2
---
$id: http://devicetree.org/schemas/soc/google/google,s5910-spmi.yaml#
$schema: http://devicetree.org/meta-schemas/core.yaml#

title: Google S5910 SPMI Modem Clock Buffer

maintainers:
  - Bobby Bones <saariuscrypto@gmail.com>

properties:
  compatible:
    const: google,s5910-spmi

  reg:
    items:
      - items:
          - minimum: 0
            maximum: 0xf
          - const: 0

  s5910,seq:
    $ref: /schemas/types.yaml#/definitions/uint32-array
    description:
      Shutdown register write sequence encoded as (delay_ms, reg, val) triples.

  s5910,on_seq:
    $ref: /schemas/types.yaml#/definitions/uint32-array
    description:
      Power-on register write sequence encoded as (delay_ms, reg, val) triples.

required:
  - compatible
  - reg
  - s5910,seq
  - s5910,on_seq

additionalProperties: false

examples:
  - |
    #include <dt-bindings/spmi/spmi.h>

    spmi-bitbang {
        #address-cells = <2>;
        #size-cells = <0>;

        s5910@5 {
            compatible = "google,s5910-spmi";
            reg = <5 SPMI_USID>;
            s5910,seq = <0 0x215 0x0f 1000 0x20e 0x04>;
            s5910,on_seq = <0 0x211 0x47 0 0x20e 0x00>;
        };
    };
```

## Documentation/devicetree/bindings/soc/google/samsung,exynos-cp-shmem.yaml
```yaml
# SPDX-License-Identifier: (GPL-2.0-only OR BSD-2-Clause)
%YAML 1.2
---
$id: http://devicetree.org/schemas/soc/google/samsung,exynos-cp-shmem.yaml#
$schema: http://devicetree.org/meta-schemas/core.yaml#

title: Samsung Exynos/Google Cellular Modem Shared Memory Map

maintainers:
  - Bobby Bones <saariuscrypto@gmail.com>

description:
  Describes shared memory regions carved out for the CPIF cellular modem
  interface driver between the host AP and a Samsung S5300/S5400 modem.

properties:
  compatible:
    const: samsung,exynos-cp-shmem

  memory-region:
    minItems: 1
    maxItems: 8
    description:
      Phandles to reserved-memory regions backing modem IPC, MSI, packet
      processor, and AoC voice shared memory.

  cp_num:
    $ref: /schemas/types.yaml#/definitions/uint32
    description: Modem instance index (0 for primary modem).

  use_mem_map_on_cp:
    $ref: /schemas/types.yaml#/definitions/uint32
    description: Non-zero if CP owns the physical memory mapping.

  regions:
    type: object
    description: Named shared-memory sub-regions carved from memory-region.
    additionalProperties:
      type: object
      properties:
        region,name:
          $ref: /schemas/types.yaml#/definitions/string
          description: Human-readable region identifier (e.g. IPC, MSI, PKTPROC).
        region,index:
          $ref: /schemas/types.yaml#/definitions/uint32
          description: CPIF region enum index.
        region,rmem:
          $ref: /schemas/types.yaml#/definitions/uint32
          description: Backing reserved-memory table index.
        region,offset:
          $ref: /schemas/types.yaml#/definitions/uint32
          description: Byte offset within the backing reserved-memory region.
        region,size:
          $ref: /schemas/types.yaml#/definitions/uint32
          description: Size in bytes of this shared-memory slice.
        region,cached:
          $ref: /schemas/types.yaml#/definitions/uint32
          description: Cacheability flag (1 for MEMREMAP_WB, 0 for MEMREMAP_WC).
      required:
        - region,name
        - region,index
        - region,rmem
        - region,offset
        - region,size
      additionalProperties: false

required:
  - compatible
  - cp_num
  - regions

additionalProperties: false

examples:
  - |
    cp-shmem {
        compatible = "samsung,exynos-cp-shmem";
        memory-region = <&cp_rmem &cp_msi_rmem>;
        cp_num = <0>;
        use_mem_map_on_cp = <0>;

        regions {
            ipc {
                region,name = "IPC";
                region,index = <3>;
                region,rmem = <0>;
                region,offset = <0>;
                region,size = <0x800000>;
                region,cached = <1>;
            };
        };
    };
```

## Documentation/devicetree/bindings/soc/google/samsung,exynos-cp.yaml
```yaml
# SPDX-License-Identifier: (GPL-2.0-only OR BSD-2-Clause)
%YAML 1.2
---
$id: http://devicetree.org/schemas/soc/google/samsung,exynos-cp.yaml#
$schema: http://devicetree.org/meta-schemas/core.yaml#

title: Samsung Exynos/Google CPIF Cellular Modem Interface

maintainers:
  - Bobby Bones <saariuscrypto@gmail.com>

description:
  Platform binding for the Samsung/Google CPIF cellular modem control, PCIe
  link transport, shared-memory doorbell/status configuration, and IO device
  channel table (S5300 / S5400).

properties:
  compatible:
    const: samsung,exynos-cp

  pci_ch_num:
    $ref: /schemas/types.yaml#/definitions/uint32
    description: PCIe domain/channel index connected to the modem endpoint.

  pci_db_addr:
    $ref: /schemas/types.yaml#/definitions/uint32
    description: Optional modem doorbell BAR base override (0 uses endpoint BAR0).

  pci_aoc_addr:
    $ref: /schemas/types.yaml#/definitions/uint32
    description: Base address of the AoC audio window mapped for modem DMA.

  cpboot_spi_bus_num:
    $ref: /schemas/types.yaml#/definitions/uint32
    description: SPI bus index when SPI boot fallback is configured.

  mif,name:
    $ref: /schemas/types.yaml#/definitions/string
    description: Modem variant name string (e.g. s5300, s5400).

  mif,cp_num:
    $ref: /schemas/types.yaml#/definitions/uint32
    description: Modem instance index matching cp-shmem cp_num.

  mif,modem_type:
    $ref: /schemas/types.yaml#/definitions/uint32

  mif,protocol:
    $ref: /schemas/types.yaml#/definitions/uint32

  mif,ipc_version:
    $ref: /schemas/types.yaml#/definitions/uint32

  mif,link_type:
    $ref: /schemas/types.yaml#/definitions/uint32

  mif,link_name:
    $ref: /schemas/types.yaml#/definitions/string

  mif,link_attrs:
    $ref: /schemas/types.yaml#/definitions/uint32

  mif,interrupt_types:
    $ref: /schemas/types.yaml#/definitions/uint32

  mif,capability_check:
    $ref: /schemas/types.yaml#/definitions/uint32

  mif,cp2ap_active_not_alive:
    $ref: /schemas/types.yaml#/definitions/uint32

  mif_off_during_volte:
    $ref: /schemas/types.yaml#/definitions/uint32

  google,clk-buffer:
    $ref: /schemas/types.yaml#/definitions/phandle
    description: Phandle to the Google S5910 SPMI clock buffer companion device.

  google,cp-pmic-spmi:
    $ref: /schemas/types.yaml#/definitions/phandle
    description: Phandle to the Google companion modem PMIC SPMI slave device.

  use-dynamic-link-spd:
    type: boolean
    description: Enable dynamic PCIe Gen1/Gen3 speed scaling in CPIF.

  tp-threshold:
    $ref: /schemas/types.yaml#/definitions/uint32
    description: Throughput upshift threshold in Mbps for dynamic PCIe link speed.

  tp-hysteresis:
    $ref: /schemas/types.yaml#/definitions/uint32
    description: Throughput hysteresis in Mbps for dynamic PCIe link speed.

  ap2cp-cp-pwr-on-gpios:
    maxItems: 1
  ap2cp-nreset-gpios:
    maxItems: 1
  ap2cp-wakeup-gpios:
    maxItems: 1
  ap2cp-dump-noti-gpios:
    maxItems: 1
  ap2cp-pda-active-gpios:
    maxItems: 1
  ap2cp-cp-wrst-gpios:
    maxItems: 1
  ap2cp-pm-wrst-gpios:
    maxItems: 1
  ap2cp-partial-rst-n-gpios:
    maxItems: 1
  cp2ap-wakeup-gpios:
    maxItems: 1
  cp2ap-phone-active-gpios:
    maxItems: 1
  cp2ap-cp-wrst-gpios:
    maxItems: 1
  cp2ap-ps-hold-gpios:
    maxItems: 1

  iodevs:
    type: object
    description: Logical character and network IO device descriptors.
    additionalProperties:
      type: object
      properties:
        iod,name:
          $ref: /schemas/types.yaml#/definitions/string
        iod,ch:
          $ref: /schemas/types.yaml#/definitions/uint32
        iod,format:
          $ref: /schemas/types.yaml#/definitions/uint32
        iod,io_type:
          $ref: /schemas/types.yaml#/definitions/uint32
        iod,link_type:
          $ref: /schemas/types.yaml#/definitions/uint32
        iod,attrs:
          $ref: /schemas/types.yaml#/definitions/uint32
        iod,ch_count:
          $ref: /schemas/types.yaml#/definitions/uint32
        iod,max_tx_size:
          $ref: /schemas/types.yaml#/definitions/uint32
        iod,ul_num_buffers:
          $ref: /schemas/types.yaml#/definitions/uint32
        iod,ul_buffer_size:
          $ref: /schemas/types.yaml#/definitions/uint32
        iod,dl_num_buffers:
          $ref: /schemas/types.yaml#/definitions/uint32
        iod,dl_buffer_size:
          $ref: /schemas/types.yaml#/definitions/uint32
        iod,option_region:
          $ref: /schemas/types.yaml#/definitions/string
      required:
        - iod,name
        - iod,ch
        - iod,format
        - iod,io_type
        - iod,link_type
        - iod,attrs
      additionalProperties: false

patternProperties:
  "^(mif,int_ap2cp|mif,irq_cp2ap|legacy_|offset_|srinfo_|capability_|ap_capability_|ap2cp_|cp2ap_|sbi_|pktproc_)":
    $ref: /schemas/types.yaml#/definitions/uint32-array

required:
  - compatible
  - mif,name
  - mif,cp_num
  - iodevs

unevaluatedProperties: false

examples:
  - |
    #include <dt-bindings/gpio/gpio.h>

    cpif {
        compatible = "samsung,exynos-cp";
        pci_ch_num = <0>;
        mif,name = "s5400";
        mif,cp_num = <0>;
        google,clk-buffer = <&s5910>;
        google,cp-pmic-spmi = <&cp_pmic>;
        use-dynamic-link-spd;

        iodevs {
            io_device_0 {
                iod,name = "umts_boot0";
                iod,ch = <0xf1>;
                iod,format = <4>;
                iod,io_type = <0>;
                iod,link_type = <1>;
                iod,attrs = <0x4200>;
            };
        };
    };
```

## Documentation/devicetree/bindings/spmi/google,bitbang-spmi-controller.yaml
```yaml
# SPDX-License-Identifier: (GPL-2.0-only OR BSD-2-Clause)
%YAML 1.2
---
$id: http://devicetree.org/schemas/spmi/google,bitbang-spmi-controller.yaml#
$schema: http://devicetree.org/meta-schemas/core.yaml#

title: Google GPIO bit-banged SPMI controller

maintainers:
  - Bobby Bones <saariuscrypto@gmail.com>

properties:
  compatible:
    const: google,bitbang-spmi-controller

  "#address-cells":
    const: 2

  "#size-cells":
    const: 0

  clk-gpios:
    maxItems: 1
    description: GPIO connected to the SPMI SCLK signal.

  dat-gpios:
    maxItems: 1
    description: GPIO connected to the SPMI SDATA signal.

  delay-us:
    $ref: /schemas/types.yaml#/definitions/uint32
    default: 100
    description: Half-cycle clock delay in microseconds.

  delay_us:
    $ref: /schemas/types.yaml#/definitions/uint32
    deprecated: true
    description: Legacy spelling of delay-us.

patternProperties:
  "@[0-9a-f]$":
    type: object
    description: Child SPMI peripheral devices on the bit-banged bus.
    properties:
      reg:
        items:
          - items:
              - minimum: 0
                maximum: 0xf
              - const: 0
    required:
      - reg
    additionalProperties: true

required:
  - compatible
  - "#address-cells"
  - "#size-cells"
  - clk-gpios
  - dat-gpios

unevaluatedProperties: false

examples:
  - |
    #include <dt-bindings/gpio/gpio.h>
    #include <dt-bindings/spmi/spmi.h>

    spmi-bitbang {
        compatible = "google,bitbang-spmi-controller";
        #address-cells = <2>;
        #size-cells = <0>;
        clk-gpios = <&gpio0 0 GPIO_ACTIVE_HIGH>;
        dat-gpios = <&gpio0 1 GPIO_ACTIVE_HIGH>;
        delay-us = <10>;

        pmic@0 {
            reg = <0 SPMI_USID>;
        };
    };
```
