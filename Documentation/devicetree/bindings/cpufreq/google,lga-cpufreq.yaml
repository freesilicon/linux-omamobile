## Documentation/devicetree/bindings/cpufreq/google,lga-cpufreq.yaml
```yaml
# SPDX-License-Identifier: (GPL-2.0-only OR BSD-2-Clause)
%YAML 1.2
---
$id: http://devicetree.org/schemas/cpufreq/google,lga-cpufreq.yaml#
$schema: http://devicetree.org/meta-schemas/core.yaml#

title: Google Laguna (Tensor G5) CPM CPUFreq and Fast-Switch Controller

maintainers:
  - Bobby Bones <saariuscrypto@gmail.com>

description:
  On Google Tensor G5 (Laguna), per-cluster CPU Operating Performance Points
  (OPPs) are discovered at runtime from the Central Power Manager (CPM) power
  block firmware service over the CPM mailbox interface, while frequency
  transitions write the target hardware pf_state index directly into dedicated
  cluster MMIO request registers.

properties:
  compatible:
    const: google,lga-cpufreq

  reg:
    maxItems: 1

  mboxes:
    description: Phandle to the Google CPM mailbox interface node.
    maxItems: 1

  google,domain-names:
    $ref: /schemas/types.yaml#/definitions/string-array
    minItems: 1
    maxItems: 8
    description:
      Ordered list of CPM power-block domain names corresponding sequentially
      to the 8-byte-strided MMIO pf_state CSR slots in the register window.

  google,cpu-domain-map:
    $ref: /schemas/types.yaml#/definitions/uint32-array
    minItems: 1
    maxItems: 16
    description:
      Zero-based domain index (into google,domain-names and MMIO CSR slots)
      assigned to each logical CPU ID in order.

required:
  - compatible
  - reg
  - mboxes
  - google,domain-names
  - google,cpu-domain-map

additionalProperties: false

examples:
  - |
    soc {
        #address-cells = <2>;
        #size-cells = <2>;

        cpufreq@200c0790 {
            compatible = "google,lga-cpufreq";
            reg = <0x0 0x200c0790 0x0 0x20>;
            mboxes = <&goog_mba_cpm_iface>;
            google,domain-names = "cpu0", "cpu1g0", "cpu1g1", "cpu2";
            google,cpu-domain-map = <0 0 1 1 1 2 2 3>;
        };
    };
```

## Documentation/devicetree/bindings/gpio/google,da9188-gpio.yaml
```yaml
# SPDX-License-Identifier: (GPL-2.0-only OR BSD-2-Clause)
%YAML 1.2
---
$id: http://devicetree.org/schemas/gpio/google,da9188-gpio.yaml#
$schema: http://devicetree.org/meta-schemas/core.yaml#

title: Dialog DA9188 PMIC physical and virtual GPIO controllers

maintainers:
  - Bobby Bones <saariuscrypto@gmail.com>

description: |
  The Dialog DA9188 PMIC on Google Tensor G5 (Laguna) exposes both a physical
  GPIO controller and a firmware-managed virtual GPIO controller over the CPM
  mailbox interface.  The virtual GPIO lines control PMIC-sequenced outputs
  such as Bluetooth power enable (BT_REG_ON) and BLE DBO latch clock.

properties:
  compatible:
    enum:
      - google,da9188-gpio
      - google,da9188-vgpio

  gpio-controller: true

  "#gpio-cells":
    const: 2

  gpio-ranges:
    maxItems: 1

  ngpios:
    minimum: 1
    maximum: 32

required:
  - compatible
  - gpio-controller
  - "#gpio-cells"

additionalProperties: false

examples:
  - |
    da9188-vgpio {
        compatible = "google,da9188-vgpio";
        gpio-controller;
        #gpio-cells = <2>;
    };
```

## Documentation/devicetree/bindings/gpu/google,lga-gpu.yaml
```yaml
# SPDX-License-Identifier: (GPL-2.0-only OR BSD-2-Clause)
%YAML 1.2
---
$id: http://devicetree.org/schemas/gpu/google,lga-gpu.yaml#
$schema: http://devicetree.org/meta-schemas/core.yaml#

title: Google Tensor G5 (Laguna) Imagination PowerVR Volcanic GPU

maintainers:
  - Bobby Bones <saariuscrypto@gmail.com>

properties:
  compatible:
    items:
      - const: google,lga-gpu
      - const: img,img-volcanic

  reg:
    minItems: 8
    maxItems: 12

  reg-names:
    minItems: 8
    items:
      - const: rgx
      - const: pfsm
      - const: req_pbha_lut
      - const: ra_lut_0
      - const: ra_lut_1
      - const: ra_lut_2
      - const: mba_glue
      - const: mba_client
      - const: gpu_control
      - const: pvtc
      - const: pvtc_pwroff
      - const: dts

  interrupts:
    maxItems: 1

  power-domains:
    minItems: 1
    maxItems: 2

  clocks:
    maxItems: 1

  clock-names:
    items:
      - const: gpu_pf_state

  iommus:
    minItems: 1
    maxItems: 2

  iommu-idmapped:
    type: boolean
    description:
      Request an identity (stage-1 bypass) IOMMU domain on gpu_smmu so the
      PowerVR MMUv4 handles GPU virtual-to-physical translation directly.

  dma-coherent: true

  memory-region:
    maxItems: 1
    description:
      Phandle to the reserved no-map firmware carveout (gpu_fw@b9f00000).

required:
  - compatible
  - reg
  - reg-names
  - interrupts
  - power-domains
  - memory-region

additionalProperties: false

examples:
  - |
    #include <dt-bindings/interrupt-controller/arm-gic.h>

    gpu@34f00000 {
        compatible = "google,lga-gpu", "img,img-volcanic";
        reg = <0x0 0x34f00000 0x0 0x100000>,
              <0x0 0x34813000 0x0 0xc>,
              <0x0 0x34e08000 0x0 0x1000>,
              <0x0 0x34900200 0x0 0x200>,
              <0x0 0x34901200 0x0 0x200>,
              <0x0 0x34902200 0x0 0x200>,
              <0x0 0x34e40000 0x0 0x48>,
              <0x0 0x34ea0000 0x0 0x4000>;
        reg-names = "rgx", "pfsm", "req_pbha_lut",
                    "ra_lut_0", "ra_lut_1", "ra_lut_2",
                    "mba_glue", "mba_client";
        interrupts = <GIC_SPI 130 IRQ_TYPE_LEVEL_HIGH 0>;
        power-domains = <&sswrp_gpu_pd>;
        iommus = <&gpu_smmu 0>, <&gpu_smmu 1>;
        iommu-idmapped;
        dma-coherent;
        memory-region = <&gpu_fw_rmem>;
    };
```

## Documentation/devicetree/bindings/pci/google,lga-pcie.yaml
```yaml
# SPDX-License-Identifier: (GPL-2.0-only OR BSD-2-Clause)
%YAML 1.2
---
$id: http://devicetree.org/schemas/pci/google,lga-pcie.yaml#
$schema: http://devicetree.org/meta-schemas/core.yaml#

title: Google Laguna (Tensor G5) PCIe Root Complex

maintainers:
  - Bobby Bones <saariuscrypto@gmail.com>

description:
  The Google Laguna (Tensor G5) PCIe host controller integrates a Synopsys
  DesignWare PCIe Root Complex with Google TOP/SII glue registers, CPM clocks
  and resets, HSIO_S power domains, and GIA error/link-event aggregators.

allOf:
  - $ref: /schemas/pci/pci-host-bridge.yaml#
  - $ref: /schemas/pci/snps,dw-pcie-common.yaml#

properties:
  compatible:
    const: google,lga-pcie

  reg:
    minItems: 5
    items:
      - description: SII wrapper registers
      - description: TOP wrapper registers
      - description: Optional PHY SRAM region for firmware handshake
      - description: DWC Data Bus Interface (DBI) registers
      - description: DWC internal Address Translation Unit (iATU) registers
      - description: PCIe configuration space aperture

  reg-names:
    oneOf:
      - items:
          - const: sii
          - const: top
          - const: phy_sram
          - const: dbi
          - const: atu
          - const: config
      - items:
          - const: sii
          - const: top
          - const: dbi
          - const: atu
          - const: config

  clocks:
    minItems: 1
    maxItems: 2

  clock-names:
    minItems: 1
    items:
      - const: phy_fw
      - const: aux_clk

  resets:
    minItems: 4
    maxItems: 4

  reset-names:
    items:
      - const: init
      - const: perst
      - const: app_hold_phy
      - const: power_up

  power-domains:
    maxItems: 1

  interrupts:
    minItems: 1
    maxItems: 10

  interrupt-names:
    oneOf:
      - minItems: 1
        items:
          - const: msi
          - const: cpl_timeout
          - const: link_down
      - minItems: 8
        items:
          - const: msi0
          - const: msi1
          - const: msi2
          - const: msi3
          - const: msi4
          - const: msi5
          - const: msi6
          - const: msi7
          - const: cpl_timeout
          - const: link_down

  perstn-gpios:
    description: Endpoint PERST# reset GPIO (active low).
    maxItems: 1

  google,perst-delay-us:
    $ref: /schemas/types.yaml#/definitions/uint32
    description: Delay in microseconds after deasserting PERST# before LTSSM start.
    default: 20000

  google,posted-rx-q-data-credits:
    $ref: /schemas/types.yaml#/definitions/uint32
    description: VC0 posted RX queue data credits programmed into DBI port logic.

  google,skip-link-equalization:
    type: boolean
    description: Disable Gen3/Gen4 link equalization phase during LTSSM training.

  google,l1-pwrgate-disable:
    type: boolean
    description: Disable SII L1 power-gating control bit.

  google,allow-suspend-in-linkup:
    type: boolean
    description:
      Allow system suspend while the link remains up and operate the root
      complex on demand via endpoint power-on/power-off requests.

  link-timeout-ms:
    $ref: /schemas/types.yaml#/definitions/uint32
    description: Link training timeout value programmed in DBI port logic.

  iommu-map: true
  dma-coherent: true

required:
  - compatible
  - reg
  - reg-names
  - clocks
  - clock-names
  - resets
  - reset-names
  - power-domains
  - interrupts
  - interrupt-names

unevaluatedProperties: false

examples:
  - |
    #include <dt-bindings/gpio/gpio.h>
    #include <dt-bindings/interrupt-controller/arm-gic.h>

    soc {
        #address-cells = <2>;
        #size-cells = <2>;

        pcie@3c500000 {
            compatible = "google,lga-pcie";
            reg = <0x0 0x3c500000 0x0 0x94>,
                  <0x0 0x3c520000 0x0 0xbc>,
                  <0x0 0x3c550000 0x0 0xa000>,
                  <0x0 0x3c800000 0x0 0xd00>,
                  <0x0 0x3cb00000 0x0 0x1000>,
                  <0x0 0x60000000 0x0 0x100000>;
            reg-names = "sii", "top", "phy_sram", "dbi", "atu", "config";
            #address-cells = <3>;
            #size-cells = <2>;
            device_type = "pci";
            linux,pci-domain = <1>;
            bus-range = <0x00 0xff>;
            ranges = <0x01000000 0x0 0x60100000 0x0 0x60100000 0x0 0x100000>,
                     <0x02000000 0x0 0x60200000 0x0 0x60200000 0x0 0x1fe00000>;
            clocks = <&hsios_phy_fw_clk>, <&hsios_aux_clk>;
            clock-names = "phy_fw", "aux_clk";
            resets = <&hsios_resets 4>,
                     <&hsios_resets 0>,
                     <&hsios_resets 1>,
                     <&hsios_resets 2>;
            reset-names = "init", "perst", "app_hold_phy", "power_up";
            power-domains = <&hsio_s_pcie_pd>;
            interrupts-extended = <&gic GIC_SPI 524 IRQ_TYPE_EDGE_RISING 0>,
                                  <&hsios_pulse_gia_4 14>,
                                  <&hsios_pulse_gia_3 17>;
            interrupt-names = "msi", "cpl_timeout", "link_down";
            perstn-gpios = <&pinctrl_hsios 11 GPIO_ACTIVE_LOW>;
            google,perst-delay-us = <20000>;
            google,posted-rx-q-data-credits = <0x51>;
            google,skip-link-equalization;
            num-lanes = <1>;
            max-link-speed = <3>;
        };
    };
```

## Documentation/devicetree/bindings/soc/google/google,cp-pmic-spmi.yaml
```yaml
# SPDX-License-Identifier: (GPL-2.0-only OR BSD-2-Clause)
%YAML 1.2
---
$id: http://devicetree.org/schemas/soc/google/google,cp-pmic-spmi.yaml#
$schema: http://devicetree.org/meta-schemas/core.yaml#

title: Google Companion Modem PMIC SPMI Slave

maintainers:
  - Bobby Bones <saariuscrypto@gmail.com>

properties:
  compatible:
    const: google,cp-pmic-spmi

  reg:
    items:
      - items:
          - minimum: 0
            maximum: 0xf
          - const: 0

  pmic-otp-reg:
    $ref: /schemas/types.yaml#/definitions/uint32
    description: Register address containing the companion PMIC OTP version.

  warm_reset_seq:
    $ref: /schemas/types.yaml#/definitions/uint32-array
    description:
      Warm-reset register write sequence encoded as (reg, val, delay_ms) triples.

required:
  - compatible
  - reg
  - warm_reset_seq

additionalProperties: false

examples:
  - |
    #include <dt-bindings/spmi/spmi.h>

    spmi-bitbang {
        #address-cells = <2>;
        #size-cells = <0>;

        pmic@0 {
            compatible = "google,cp-pmic-spmi";
            reg = <0 SPMI_USID>;
            pmic-otp-reg = <0x30e>;
            warm_reset_seq = <0x675 0xa1 0 0x67d 0xbe 0>;
        };
    };
```
