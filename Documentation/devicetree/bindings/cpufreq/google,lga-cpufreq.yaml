## Documentation/devicetree/bindings/spmi/smartdv,spmi.yaml
```yaml
# SPDX-License-Identifier: (GPL-2.0-only OR BSD-2-Clause)
%YAML 1.2
---
$id: http://devicetree.org/schemas/spmi/smartdv,spmi.yaml#
$schema: http://devicetree.org/meta-schemas/core.yaml#

title: SmartDV SPMI controller

maintainers:
  - Bobby Bones <saariuscrypto@gmail.com>

allOf:
  - $ref: spmi.yaml#

properties:
  compatible:
    enum:
      - smartdv,spmi
      - google,smartdv-spmi

  reg:
    maxItems: 1

  interrupts:
    maxItems: 1

  clocks:
    maxItems: 1

  resets:
    maxItems: 1

  clock-frequency:
    $ref: /schemas/types.yaml#/definitions/uint32
    description: Bus clock frequency in Hz.

  master_arb_en:
    $ref: /schemas/types.yaml#/definitions/uint32
    description: Enable SPMI bus arbitration when multiple masters share the bus.

  master_id:
    $ref: /schemas/types.yaml#/definitions/uint32
    description: SPMI master identifier (0-3).

  spmi_ver:
    $ref: /schemas/types.yaml#/definitions/uint32
    description: Supported SPMI protocol version encoded in CTRL register.

  arb_retry_limit:
    $ref: /schemas/types.yaml#/definitions/uint32
    description: Arbitration retry limit programmed into CTRL register.

  prescalar:
    $ref: /schemas/types.yaml#/definitions/uint32
    description: Clock divider prescalar programmed into CTRL register.

  read_latancy:
    $ref: /schemas/types.yaml#/definitions/uint32
    description: Read data capture latency in clock cycles (legacy DT spelling).

  read-latency:
    $ref: /schemas/types.yaml#/definitions/uint32
    description: Read data capture latency in clock cycles.

  arb_scl_delay:
    $ref: /schemas/types.yaml#/definitions/uint32
    description: SCLK arbitration delay programmed into CTRL register.

required:
  - compatible
  - reg

unevaluatedProperties: false

examples:
  - |
    #include <dt-bindings/spmi/spmi.h>

    spmi@53f1000 {
        compatible = "smartdv,spmi";
        reg = <0x0 0x053f1000 0x0 0x300>;
        clock-frequency = <19200000>;
        master_arb_en = <1>;
        master_id = <0>;
        spmi_ver = <1>;
        arb_retry_limit = <6>;
        prescalar = <1>;
        read_latancy = <0>;
        arb_scl_delay = <0>;
        #address-cells = <2>;
        #size-cells = <0>;

        pmic@f {
            reg = <0xf SPMI_USID>;
        };
    };
```

## Documentation/devicetree/bindings/thermal/google,lga-tmu.yaml
```yaml
# SPDX-License-Identifier: (GPL-2.0-only OR BSD-2-Clause)
%YAML 1.2
---
$id: http://devicetree.org/schemas/thermal/google,lga-tmu.yaml#
$schema: http://devicetree.org/meta-schemas/core.yaml#

title: Google Laguna (Tensor G5) CPM Thermal Management Unit

maintainers:
  - Bobby Bones <saariuscrypto@gmail.com>

description:
  On Google Tensor G5 (Laguna), on-die Thermal Management Unit (TMU) sensors
  are managed by the Central Power Manager (CPM) firmware. The operating system
  polls temperatures asynchronously over the CPM mailbox interface instead of
  accessing TMU MMIO registers directly.

  Standard sensor indices exposed via "#thermal-sensor-cells" map to the CPM
  firmware zones BIG (0), BIG_MID (1), MID (2), LITTLE (3), GPU (4), TPU (5),
  AUR (6), ISP (7), MEM (8), and AOC (9).

properties:
  compatible:
    const: google,lga-tmu

  mboxes:
    description: Phandle to the Google CPM mailbox interface node.
    maxItems: 1

  '#thermal-sensor-cells':
    const: 1

required:
  - compatible
  - mboxes
  - '#thermal-sensor-cells'

additionalProperties: false

examples:
  - |
    thermal-sensor {
        compatible = "google,lga-tmu";
        mboxes = <&goog_mba_cpm_iface>;
        #thermal-sensor-cells = <1>;
    };
```

## Documentation/devicetree/bindings/ufs/google,ufshc.yaml
```yaml
# SPDX-License-Identifier: GPL-2.0-only OR BSD-2-Clause
%YAML 1.2
---
$id: http://devicetree.org/schemas/ufs/google,ufshc.yaml#
$schema: http://devicetree.org/meta-schemas/core.yaml#

title: Google Tensor (Laguna) Universal Flash Storage (UFS) Controller

maintainers:
  - Bobby Bones <saariuscrypto@gmail.com>

properties:
  compatible:
    const: google,ufshc

  reg:
    minItems: 2
    maxItems: 6

  reg-names:
    minItems: 2
    maxItems: 6

  clocks:
    minItems: 1
    maxItems: 2

  clock-names:
    minItems: 1
    items:
      - const: ref_clk
      - const: aux_clk

  interrupts:
    minItems: 1
    maxItems: 17

  resets:
    maxItems: 1

  reset-names:
    const: phy_rst

  reset-gpios:
    maxItems: 1

  power-gpios:
    maxItems: 1

  power-domains:
    minItems: 1
    maxItems: 2

  power-domain-names:
    minItems: 1
    items:
      - const: ufs_prep_pd
      - const: ufs_pd

  vdd0p75-supply:
    description: Phandle to 0.75V UFS PHY supply regulator.

  vdd1p2-supply:
    description: Phandle to 1.2V UFS PHY supply regulator.

  gsa-device:
    $ref: /schemas/types.yaml#/definitions/phandle
    description: Phandle to the GSA remote processor/crypto device node.

  phy-cal-data:
    $ref: /schemas/types.yaml#/definitions/uint32-array
    description:
      Array of packed 16-bit M-PHY indirect APB address and value pairs
      (val << 16 | addr).

  google,enable-phy-calibration:
    type: boolean
    description: Apply board-specific M-PHY indirect APB calibration table.

  google,skip-ufs-phy-init:
    type: boolean
    description: Skip M-PHY RMMI/SRAM/calibration initialization sequence.

  google,skip-mcq-multi-intr:
    type: boolean
    description: Disable per-queue MCQ interrupt registration.

  google,toggle-resetb-on-reset:
    type: boolean
    description: Toggle reset GPIO on UFS device reset callback.

required:
  - compatible
  - reg
  - reg-names
  - clocks
  - clock-names
  - interrupts
  - resets
  - reset-names

allOf:
  - $ref: ufs-common.yaml

unevaluatedProperties: false

examples:
  - |
    #include <dt-bindings/interrupt-controller/arm-gic.h>
    #include <dt-bindings/gpio/gpio.h>

    ufs@3c400000 {
        compatible = "google,ufshc";
        reg = <0x0 0x3c400000 0x0 0x1000>,
              <0x0 0x3c410000 0x0 0x504>;
        reg-names = "ufs_hc", "ufs_top";
        clocks = <&hsios_gpio_ref_tcx0_clk>, <&hsios_aux_clk>;
        clock-names = "ref_clk", "aux_clk";
        interrupts = <GIC_SPI 541 IRQ_TYPE_LEVEL_HIGH>;
        resets = <&hsios_resets 3>;
        reset-names = "phy_rst";
        reset-gpios = <&pinctrl_hsios 0 GPIO_ACTIVE_HIGH>;
        power-gpios = <&pinctrl_hsios 8 GPIO_ACTIVE_HIGH>;
        google,enable-phy-calibration;
        phy-cal-data = <0x2f13129 0x2f63329>;
    };
```

## drivers/accel/edgetpu-laguna/Kconfig
```kconfig
# SPDX-License-Identifier: GPL-2.0-only

config DRM_ACCEL_EDGETPU_LAGUNA
	tristate "Google Tensor G5 (Laguna) EdgeTPU NPU"
	depends on DRM_ACCEL
	depends on HAS_IOMEM && OF
	depends on IOMMU_API
	depends on DMA_SHARED_BUFFER
	depends on PM
	depends on GOOGLE_GSA
	depends on ARM64 || COMPILE_TEST
	select FW_LOADER
	select GENERIC_ALLOCATOR
	select IOMMU_IOVA
	help
	  Minimal clean-room driver for the Google Tensor G5 (Laguna / buenos)
	  EdgeTPU neural accelerator. Exposes /dev/edgetpu-soc with the
	  Litebuf VII inference ioctls, arm,smmu-v3 36-bit DMA-BUF mappings,
	  KCI firmware control, and GSA firmware authentication.

	  To compile this driver as a module, choose M here: the module will
	  be called edgetpu-laguna.
```

## drivers/clk/google/Kconfig
```kconfig
# SPDX-License-Identifier: GPL-2.0-only

config GOOGLE_CPM_CLK
	tristate "Google CPM clock driver"
	depends on ARCH_EXYNOS || COMPILE_TEST
	depends on GOOGLE_MBA_CPM_INTERFACE
	help
	  Enables configuration of Google Tensor G5 (Laguna) LPCM clocks via
	  the Central Power Manager (CPM) over the common clock framework.
```

## drivers/gpu/drm/dc9x00/Kconfig
```kconfig
# SPDX-License-Identifier: GPL-2.0-only
config DRM_DC9X00
	tristate "VeriSilicon DC9x00 display controller (Google Laguna)"
	depends on DRM && OF
	depends on ARCH_EXYNOS || COMPILE_TEST
	select DRM_CLIENT_SELECTION
	select DRM_KMS_HELPER
	select DRM_GEM_DMA_HELPER
	select DRM_PANEL
	select DRM_BRIDGE
	select DRM_DISPLAY_HELPER
	select DRM_DISPLAY_DSC_HELPER
	select DRM_PANEL_BRIDGE
	select DRM_BRIDGE_CONNECTOR
	select DRM_MIPI_DSI
	select GENERIC_PHY
	select GENERIC_PHY_MIPI_DPHY
	select VIDEOMODE_HELPERS
	help
	  Clean-room DRM/KMS driver for VeriSilicon DC9x00 display controller,
	  DesignWare MIPI DSI-2 host, Synopsys CDPHY G301, Laguna panels, and
	  opt-in PowerVR Stage G0 register probe on Tensor G5 Laguna.
```

## drivers/pinctrl/google/Kconfig
```kconfig
# SPDX-License-Identifier: GPL-2.0-only

config PINCTRL_GOOGLE
	tristate
	select PINMUX
	select PINCONF
	select GENERIC_PINCONF
	select GPIOLIB
	select GPIOLIB_IRQCHIP
	select OF_GPIO
	help
	  Core pin controller and GPIO library for Google Tensor SoCs.

config PINCTRL_LGA
	tristate "Google LGA (Pixel 10) pin controller driver"
	depends on ARCH_EXYNOS || COMPILE_TEST
	depends on OF
	select PINCTRL_GOOGLE
	default ARCH_EXYNOS
	help
	  Say Y here to enable the pin controller and GPIO driver for the
	  Google Tensor G5 (LGA / Laguna) SoC blocks including CPM, AOC,
	  LSIOE, LSIOS, LSION, HSION, HSIOS, DPU, and GDMC.
```

## drivers/pmdomain/google/Kconfig
```kconfig
# SPDX-License-Identifier: GPL-2.0-only

config GOOGLE_POWER_CONTROLLER
	tristate "Google CPM power controller driver"
	depends on ARCH_EXYNOS || COMPILE_TEST
	depends on GOOGLE_MBA_CPM_INTERFACE
	select PM_GENERIC_DOMAINS
	help
	  Enables generic power domain (genpd) support for Google Tensor G5
	  (Laguna) SoC power domains controlled via CPM LPB/LPCM mailboxes.
```

## drivers/soc/google/Kconfig
```kconfig
# SPDX-License-Identifier: GPL-2.0-only

if ARCH_EXYNOS || COMPILE_TEST

menu "Google SoC drivers"

config GOOGLE_MBA_CPM_INTERFACE
	tristate "Google CPM mailbox interface"
	depends on MAILBOX && GOOGLE_MBA_CTRL
	help
	  Enable the Google MailBox Array (MBA) CPM transport interface used
	  on Google Tensor G5 (Laguna) SoCs for clock, reset, and power
	  controller messaging with the Central Power Manager (CPM).

config GOOGLE_GSA
	tristate "Google GSA mailbox"
	depends on DEBUG_FS
	help
	  The GSA is the security core of Google Tensor SoCs. It authenticates
	  and loads the firmware of other cores, such as the AoC (the audio
	  and sensor DSP) and the EdgeTPU, and is reached either directly
	  through Samsung-style mailbox registers (gs201/zumapro) or via a
	  Linux mailbox controller (google,gs101-gsa-v1 on Laguna).

	  This driver provides firmware loading and lifecycle control for AoC
	  and EdgeTPU drivers and exposes status queries in debugfs.

config GOOGLE_GSA_TRUSTY
	bool "AoC and TPU state commands through Trusty"
	depends on GOOGLE_GSA && TRUSTY_VIRTIO_IPC
	depends on TRUSTY_VIRTIO_IPC=y || GOOGLE_GSA=m
	help
	  Send AoC and EdgeTPU state commands (start, suspend, resume,
	  shutdown, get state) to the GSA's hwmgr.aoc and hwmgr.tpu services
	  in Trusty, as Google's kernels do. Without it, only the mailbox
	  command path can be tried (aoc_cmd_mbox=1 / tpu_cmd_mbox=1).

config GS201_AOC_SYSMMU
	tristate "gs201 AoC System MMU static windows"
	help
	  Programs the AoC's System MMU with the fixed windows its firmware
	  expects (from the firmware image header), as 1 MiB sections. Used by
	  the AoC driver.

config GS201_AOC_BOOT
	tristate "gs201 AoC firmware boot (bring-up)"
	depends on GOOGLE_GSA && GS201_AOC_SYSMMU && DEBUG_FS
	help
	  Boots the AoC firmware step by step from debugfs: power request,
	  System MMU windows, GSA authentication, start. It does not run the
	  AoC's services; it only checks that the firmware comes up. For
	  bring-up only.

config GS201_AOC_RAILS
	tristate "gs201 AoC microphone and sensor supplies over ACPM (bring-up)"
	depends on EXYNOS_ACPM_PROTOCOL
	help
	  Reads, and with enable=1 turns on, the five S2MPG12/S2MPG13 LDOs that
	  feed the AoC's digital microphones and sensors, until there is an
	  S2MPG12/13 regulator driver. For bring-up only.

config GS201_CAM_POWER
	tristate "gs201 camera module power sequencing and ID reads (bring-up)"
	depends on I2C && DEBUG_FS && OF
	help
	  Binds to a camera module's I2C device and, from debugfs, powers it
	  up and down in the order and with the delays the device tree
	  gives, and reads single identification registers from a list in
	  the device tree. It never writes to the device. For bring-up only,
	  until there are sensor drivers.

config GS201_AOC_MBOX
	tristate "gs201 AoC mailboxes"
	depends on MAILBOX
	help
	  The doorbell and shared-register mailboxes between the AP and the
	  AoC (Google's whitechapel mailbox driver).

config GS201_AOC
	tristate "gs201 AoC core (Google's driver)"
	depends on GOOGLE_GSA && GS201_AOC_SYSMMU && GS201_AOC_MBOX
	help
	  Google's AoC core driver, ported: loads and authenticates the AoC
	  firmware through the GSA, starts it, and exposes its services on the
	  AoC bus. Firmware loading is triggered from sysfs (firmware), not at
	  probe. Supports gs201 and zumapro (Tensor G4).

config GS201_AOC_CHAR
	tristate "gs201 AoC service character devices"
	depends on GS201_AOC
	help
	  /dev/acd-<service> character devices for AoC services
	  (aoc_char_dev), and channelized ones for services such as the
	  sensor framework (aoc_channel_dev).

config GS201_AOC_ALSA
	tristate "gs201 AoC sound card (Google's driver)"
	depends on GS201_AOC && SND_SOC
	select SND_COMPRESS_OFFLOAD
	help
	  Google's AoC ALSA/ASoC driver, ported: the AoC's playback and
	  capture endpoints, its audio routing controls, and a sound card with
	  the speaker amplifiers on TDM 0. The card enforces the speaker
	  limits in device/cheetah/AUDIO-PLAN.md.

config GOOGLE_MODEMCTL
	tristate "Google modem event notifier chains"
	help
	  Provides raw notifier chains for cellular modem lifecycle events,
	  voice-call state transitions, and external force-crash requests
	  shared between Google modem interface drivers and audio subsystems
	  on Google Tensor SoCs.

config S5910
	tristate "Google S5910 SPMI modem clock buffer"
	depends on SPMI && OF
	select REGMAP_SPMI
	help
	  This enables support for the S5910 SPMI reference clock buffer
	  companion device used by Samsung cellular modems on Google Tensor
	  platforms, executing power-on and shutdown register sequences over
	  the sideband SPMI bus.

config CP_PMIC
	tristate "Google cellular modem companion PMIC over SPMI"
	depends on SPMI && OF
	select REGMAP_SPMI
	help
	  This enables support for the cellular modem companion PMIC over
	  SPMI on Google Tensor platforms, providing OTP revision reads and
	  warm-reset register sequencing for S5400-class modems during
	  modem bring-up and recovery.

source "drivers/soc/google/cpif/Kconfig"
source "drivers/soc/google/gnssif_spi/Kconfig"

endmenu

endif
```

## sound/soc/google/Kconfig
```kconfig
# SPDX-License-Identifier: GPL-2.0-only
menu "Google"

config SND_SOC_CHV3_I2S
	tristate "Google Chameleon v3 I2S device"
	help
	  Enable support for the Google Chameleon v3 I2S device.

config SND_SOC_GOOGLE_LGA_AOC
	tristate "Google Tensor G5 (Laguna) AoC audio driver"
	depends on GOOGLE_LGA_AOC
	help
	  Enable clean-room ALSA ASoC PCM playback, capture, and mixer
	  controls backed by the Google Tensor G5 (Laguna) Always-on
	  Compute (AoC) firmware IPC rings and control queues.

	  To compile this driver as a module, choose M here: the module
	  will be called snd-soc-lga-aoc.

endmenu
```
